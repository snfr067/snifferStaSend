## main/Kconfig.projbuild
```kconfig
menu "Custom Configuration"

	config ESP_AP_WIFI_SSID
		string "AP WiFi SSID"
		default "myssid"
		help
		SSID (network name) for the example to connect to.

	config ESP_AP_WIFI_PASSWORD
		string "AP WiFi Password"
		default "mypassword"
		help
		WiFi password (WPA or WPA2) for the example to use.
		
	config ESP_STA_WIFI_SSID
		string "STA WiFi SSID"
		default "myssid"
		help
		SSID (network name) for this device to connect to.

	config ESP_STA_WIFI_PASSWORD
		string "STA WiFi Password"
		default "mypassword"
		help
		WiFi password (WPA or WPA2) for this device to use.
		
	config SNIFFER_SETTING_GET_HOST_IP
        string "The host ip for sniffer to get settings"
        default "127.0.0.1"
		help
			Set host server IP address. 
			
	config SNIFFER_SETTING_GET_HOST_PORT
        int "The host port for sniffer to get settings"
        default 8080
		help
			Set host server port. 
			
	config SNIFFER_SETTING_GET_LOCAL_PORT
        int "The local port for sniffer to get settings"
        default 8080
		help
			Set local socket port. 
			
	config SNIFFER_SETTING_GET_MAX_FAILED_LIMIT
        int "The max times of getting sniffer setting failed."
        default 10
		help
			Set max times of getting sniffer setting failed. 
			
	config SNIFFER_CHANNEL
        int "Sniffer Channel"
        default 1
		help
			The channel of sniffer.

    config FIRMWARE_UPG_URL
        string "HTTP Server URL"
        default "https://192.168.0.3:8070/hello-world.bin"
        help
            HTTP Server IP to download the image file from.

            See example README.md for details.
	
	config SOCKET_DEST_IP
        string "Socket Dest IP"
        default "127.0.0.1"
		help
			Set Socket sever IP address. 
			
	config SOCKET_DEST_PORT_RSSI
        int "Socket Port for RSSI"
        default 8888
		help
			Set Socket sever port for rssi. 				
	
	config SOCKET_DEST_PORT_CK
        int "Socket Port for RSSI"
        default 8889
		help
			Set Socket sever port for check message. 		
			
	config REPORT_FREQUENCY
        int "The frequency(ms.) of check message"
        default 3000
		help
			Set the frequency(ms.) of check message.
			
    config GPIO_DIAGNOSTIC
        int "Number of the GPIO input for diagnostic"
        range 0 39
        default 4
        help
            Used to demonstrate how a rollback works.
            The selected GPIO will be configured as an input with internal pull-up enabled.
            To trigger a rollback, this GPIO must be pulled low while the message
            `Diagnostics (5 sec)...` which will be on first boot.
            If GPIO is not pulled low then the operable of the app will be confirmed.
			
endmenu
```
